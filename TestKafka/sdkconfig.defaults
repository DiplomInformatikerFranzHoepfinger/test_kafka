## TestKafka/sdkconfig.defaults
```kconfig
CONFIG_ESP_MAIN_TASK_STACK_SIZE=16000
CONFIG_ESP_IPC_TASK_STACK_SIZE=4096
CONFIG_ESP_TIMER_TASK_STACK_SIZE=4584
CONFIG_FREERTOS_IDLE_TASK_STACKSIZE=2536
CONFIG_FREERTOS_TIMER_TASK_STACK_DEPTH=3048
CONFIG_FREERTOS_WATCHPOINT_END_OF_STACK=y
```
